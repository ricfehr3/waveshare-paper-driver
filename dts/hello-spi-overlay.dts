/dts-v1/;
/plugin/;

#include <dt-bindings/gpio/gpio.h>

&spi0 {
    status = "okay";
};

&spi0 {
    /* Help dtc validate children of this fragment like a SPI bus */
    #address-cells = <1>;
    #size-cells = <0>;

    epaper@0 {
        compatible = "waveshare,epaperdev";
        reg = <0>;                      /* CS0 */
        spi-max-frequency = <4000000>;

        /* last cell: 0=ACTIVE_HIGH, 1=ACTIVE_LOW (use numbers to avoid cpp) */
        res-gpios   = <&gpio 17 GPIO_ACTIVE_HIGH>;
        busy-gpios  = <&gpio 24 GPIO_ACTIVE_HIGH>;
        dc-gpios    = <&gpio 25 GPIO_ACTIVE_HIGH>;
    };
};

